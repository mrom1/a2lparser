/* Minimal Module using Include Mechanism */
/begin MODULE MODULE_INCLUDES "TEST_MODULE_NESTED_INCLUDES"
/* Includes the A2ML section from "AMLTemplate.aml" */
/include "../AMLTemplate.aml"
/* Includes Measurement sections */
/include "MEASUREMENTS.a2l"
/* Includes Characteristics sections */
/include "./CHARACTERISTICS.a2l"
/* Includes Transformer sections */
/include TRANSFORMERS.a2l
/end MODULE
